AUTOSAR XML (schema 00049)
package /ota/executables
  executable ota_exec
    root sw component prototype RootSwComponentPrototype1: application-type=ota_swc
  executable ucm_exec
    root sw component prototype RootSwComponentPrototype1: application-type=ucm_swc
  executable sm_exec
    root sw component prototype RootSwComponentPrototype1: application-type=sm_swc
