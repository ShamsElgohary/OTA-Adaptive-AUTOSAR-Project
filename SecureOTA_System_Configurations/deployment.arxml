AUTOSAR XML (schema 00049)
package /ota/deployments
  someip service interface deployment PackageManager_someip_dep: service-interface=PackageManager, service-interface-id=1000, service-interface-version={major-version=1, minor-version=0}
    someip field deployment CurrentState: field=CurrentStatus
      get SomeipMethodDeployment1: method-id=100
    10 x someip method deployment:
      TransferStart: method=TransferStart, method-id=101
      TransferData: method=TransferData, method-id=100
      TransferExit: method=TransferExit, method-id=102
      TransferDelete: method=TransferDelete, method-id=103
      ProcessSwPackage: method=ProcessSwPackage, method-id=104
      Activate: method=Activate, method-id=105
      GetSwClusterInfo: method=GetSwClusterInfo, method-id=106
      Rollback: method=Rollback, method-id=107
      RevertProcessedSwPackages: method=RevertProcessedSwPackages, method-id=108
      Finish: method=Finish, method-id=109
  someip service interface deployment UpdateRequest_someip_dep: service-interface=PackageManager, service-interface-id=2000, service-interface-version={major-version=1, minor-version=0}
    4 x someip method deployment:
      StartUpdateSession: method=StartUpdateSession, method-id=100
      PrepareUpdate: method=PrepareUpdate, method-id=101
      VerifyUpdate: method=VerifyUpdate, method-id=102
      StopUpdateSession: method=StopUpdateSession, method-id=103
package /ota/deployments/Instances
  provided someip service instance PackageManager_provided_instance: service-interface-deployment=PackageManager_someip_dep, service-instance-id=1
  provided someip service instance UpdateRequest_provided_instance: service-interface-deployment=UpdateRequest_someip_dep, service-instance-id=1
  required someip service instance UpdateRequest_requested_instance: service-interface-deployment=UpdateRequest_someip_dep, required-service-instance-id=1
  required someip service instance PackageManager_required_instance: service-interface-deployment=PackageManager_someip_dep, required-service-instance-id=1
