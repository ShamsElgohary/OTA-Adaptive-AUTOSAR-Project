AUTOSAR XML (schema 00049)
package /ota/mappings
  5 x someip service instance to machine mapping, all with communication-connector=LocalConnection:
    provided_package_manager_mapping: service-instance=PackageManager_provided_instance, tcp-port=2253, udp-port=2253
    provided_car_control_mapping: service-instance=CarControl_provided_instance, tcp-port=2254, udp-port=2254
    required_update_request_mapping: service-instance=UpdateRequest_requested_instance, tcp-port=2522, udp-port=2522
    provided_update_request_mapping: service-instance=UpdateRequest_provided_instance, tcp-port=2522, udp-port=2522
    required_package_manager_mapping: service-instance=PackageManager_required_instance, tcp-port=2253, udp-port=2253
  5 x service instance to port prototype mapping:
    provided_package_manager_port_mapping: port-prototype=RootSwComponentPrototype1.package_manager, process-design=ucm_process_design, process=ota_process, service-instance=PackageManager_provided_instance
    required_package_manager_port_mapping: port-prototype=RootSwComponentPrototype1.package_manager, process-design=ota_process_design, process=ota_process, service-instance=PackageManager_required_instance
    required_update_request_port_mapping: port-prototype=RootSwComponentPrototype1.update_request, process-design=ucm_process_design, process=ucm_process, service-instance=UpdateRequest_requested_instance
    provided_update_request_port_mapping: port-prototype=RootSwComponentPrototype1.update_request, process-design=sm_process_design, process=sm_process, service-instance=UpdateRequest_provided_instance
    provided_car_control_port_mapping: port-prototype=RootSwComponentPrototype1.car_control, process-design=Car_GUI_process_design, process=Car_GUI_process, service-instance=CarControl_provided_instance
