AUTOSAR XML (schema 00049)
package /ota/machines
  machine secure_ota_machine: machine-design=secure_ota_machine_design
  machine design secure_ota_machine_design
    ethernet communication connector LocalConnection
