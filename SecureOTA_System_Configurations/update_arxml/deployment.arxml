AUTOSAR XML (schema 00049)
package /ota/deployments
  someip service interface deployment PackageManager_someip_dep: service-interface=PackageManager, service-interface-id=2, service-interface-version={major-version=0, minor-version=1}
    someip field deployment CurrentStatus: field=CurrentStatus
      get SomeipMethodDeployment1: method-id=11
    10 x someip method deployment:
      TransferStart: method=TransferStart, method-id=1
      TransferData: method=TransferData, method-id=2
      TransferExit: method=TransferExit, method-id=3
      TransferDelete: method=TransferDelete, method-id=4
      ProcessSwPackage: method=ProcessSwPackage, method-id=5
      Activate: method=Activate, method-id=6
      GetSwClusterInfo: method=GetSwClusterInfo, method-id=7
      Rollback: method=Rollback, method-id=8
      RevertProcessedSwPackages: method=RevertProcessedSwPackages, method-id=9
      Finish: method=Finish, method-id=10
  someip service interface deployment UpdateRequest_someip_dep: service-interface=PackageManager, service-interface-id=1, service-interface-version={major-version=0, minor-version=1}
    4 x someip method deployment:
      StartUpdateSession: method=StartUpdateSession, method-id=1
      PrepareUpdate: method=PrepareUpdate, method-id=2
      VerifyUpdate: method=VerifyUpdate, method-id=3
      StopUpdateSession: method=StopUpdateSession, method-id=4
  someip service interface deployment CarControl_someip_dep: service-interface=CarControl, service-interface-id=3, service-interface-version={major-version=0, minor-version=1}
    someip method deployment ProcessCarAction: method=ProcessCarAction, method-id=1
package /ota/deployments/Instances
  provided someip service instance PackageManager_provided_instance: service-interface-deployment=PackageManager_someip_dep, service-instance-id=1
  provided someip service instance UpdateRequest_provided_instance: service-interface-deployment=UpdateRequest_someip_dep, service-instance-id=1
  provided someip service instance CarControl_provided_instance: service-interface-deployment=CarControl_someip_dep, service-instance-id=1
  required someip service instance UpdateRequest_requested_instance: service-interface-deployment=UpdateRequest_someip_dep, required-service-instance-id=1
  required someip service instance PackageManager_required_instance: service-interface-deployment=PackageManager_someip_dep, required-service-instance-id=1
