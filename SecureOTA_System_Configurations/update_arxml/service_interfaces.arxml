AUTOSAR XML (schema 00049)
package /ota/service_interfaces
  service interface UpdateRequest
    namespaces:
      symbol props ara
      symbol props sm
      symbol props UpdateRequest
    methods:
      4 x operation:
        StartUpdateSession
          arg AppError: type=SM_ApplicationError, direction=OUT
        PrepareUpdate
          arg FunctionGroups: type=FunctionGroupList, direction=IN
          arg AppError: type=SM_ApplicationError, direction=OUT
        VerifyUpdate
          arg FunctionGroups: type=FunctionGroupList, direction=IN
          arg AppError: type=SM_ApplicationError, direction=OUT
        StopUpdateSession: fire-and-forget=true
  service interface CarControl
    namespaces:
      symbol props carcontrol
    methods:
      operation ProcessCarAction
        arg Action: type=CarActionType, direction=IN
        arg Result: type=CarResultType, direction=OUT
  service interface PackageManager
    namespaces:
      symbol props ara
      symbol props ucm
      symbol props pkgmgr
    field CurrentStatus: type=PackageManagerStatusType, has-getter=true, has-notifier=false, has-setter=false
    methods:
      10 x operation:
        Finish
          arg OperationReturn: type=OperationResultType, direction=OUT
        TransferStart
          4 x arg:
            Size: type=uint64_t, direction=IN
            id: type=TransferIdType, direction=OUT
            BlockSize: type=uint32_t, direction=OUT
            TransferStartResult: type=OperationResultType, direction=OUT
        TransferData
          4 x arg:
            id: type=TransferIdType, direction=IN
            data: type=ByteVectorType, direction=IN
            blockCounter: type=uint64_t, direction=IN
            OperationReturn: type=OperationResultType, direction=OUT
        TransferExit
          arg id: type=TransferIdType, direction=IN
          arg OperationReturn: type=OperationResultType, direction=OUT
        TransferDelete
          arg id: type=TransferIdType, direction=IN
          arg OperationReturn: type=OperationResultType, direction=OUT
        ProcessSwPackage
          arg id: type=TransferIdType, direction=IN
          arg OperationReturn: type=OperationResultType, direction=OUT
        Activate
          arg OperationReturn: type=OperationResultType, direction=OUT
        GetSwClusterInfo
          arg vectorOfClusterInfo: type=SwClusterInfoVectorType, direction=OUT
        Rollback
          arg OperationReturn: type=OperationResultType, direction=OUT
        RevertProcessedSwPackages
          arg OperationReturn: type=OperationResultType, direction=OUT
