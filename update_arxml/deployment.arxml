AUTOSAR XML (schema 00049)
package /ota/deployments
  someip service interface deployment TestInterface_someip_dep: service-interface=Test_Interface, service-interface-id=3, service-interface-version={major-version=0, minor-version=1}
    someip method deployment Test_Method: method=Test_Method, method-id=1
package /ota/deployments/Instances
  provided someip service instance TestInterface_provided_instance: service-interface-deployment=TestInterface_someip_dep, service-instance-id=3
