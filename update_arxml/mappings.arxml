AUTOSAR XML (schema 00049)
package /ota/mappings
  someip service instance to machine mapping provided_Test_Interface_mapping: communication-connector=LocalConnection, service-instance=PackageManager_provided_instance, tcp-port=8080, udp-port=8080
  service instance to port prototype mapping provided_Test_Interface_port_mapping: port-prototype=RootSwComponentPrototype1.test_interface, process-design=ucm_process_design, process=ucm_process, service-instance=UpdateRequest_requested_instance
