AUTOSAR XML (schema 00049)
package /ota/software_componenets
  adaptive application sw component type Test_Package
    provide port test_interface: provided-interface=Test_Interface
