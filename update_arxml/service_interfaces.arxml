AUTOSAR XML (schema 00049)
package /ota/service_interfaces
  service interface Test_Interface
    namespaces:
      symbol props ara
      symbol props test
    methods:
      operation Test_Method
        arg Action: type=ActionType, direction=IN
        arg Result: type=ResultType, direction=OUT
