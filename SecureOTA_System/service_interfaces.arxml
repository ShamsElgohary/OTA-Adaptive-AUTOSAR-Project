AUTOSAR XML (schema 00049)
package /ota/service_interfaces
  service interface UpdateRequest
    namespaces:
      symbol props ara
      symbol props sm
    methods:
      4 x operation:
        StartUpdateSession: possible-ap-error=[kPrepareFailed, kRejected, kRollbackFailed, kVerifyFailed]
        PrepareUpdate: possible-ap-error=[kPrepareFailed, kRejected, kRollbackFailed, kVerifyFailed]
          arg FunctionGroups: type=FunctionGroupList, direction=IN
        VerifyUpdate: possible-ap-error=[kPrepareFailed, kRejected, kRollbackFailed, kVerifyFailed]
          arg FunctionGroups: type=FunctionGroupList, direction=IN
        StopUpdateSession: fire-and-forget=true
  service interface PackageManager
    namespaces:
      symbol props ara
      symbol props ucm
      symbol props pkgmgr
    field CurrentStatus: type=PackageManagerStatusType, has-getter=true, has-notifier=false, has-setter=false
    methods:
      10 x operation:
        Finish
          arg Result: type=OperationResultOutput, direction=OUT
        TransferStart
          arg Size: type=uint64_t, direction=IN
          arg TransferStartOutput: type=TransferStartOutput, direction=OUT
        TransferData
          4 x arg:
            id: type=TransferIdType, direction=IN
            data: type=ByteVectorType, direction=IN
            blockCounter: type=uint64_t, direction=IN
            ArgumentDataPt: type=OperationResultType, direction=OUT
        TransferExit
          arg id: type=TransferIdType, direction=IN
          arg OperationResultOutput: type=OperationResultOutput, direction=OUT
        TransferDelete
          arg id: type=TransferIdType, direction=IN
          arg OperationResultOutput: type=OperationResultOutput, direction=OUT
        ProcessSwPackage
          arg id: type=TransferIdType, direction=IN
          arg OperationResultOutput: type=OperationResultOutput, direction=OUT
        Activate
          arg OperationResultOutput: type=OperationResultOutput, direction=OUT
        GetSwClusterInfo
          arg GetSWClusterInfoOutput: type=SwClusterInfoVectorType, direction=OUT
        Rollback
          arg Result: type=OperationResultOutput, direction=OUT
        RevertProcessedSwPackages
          arg Result: type=OperationResultOutput, direction=OUT
