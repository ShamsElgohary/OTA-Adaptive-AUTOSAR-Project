AUTOSAR XML (schema 00049)
package /ota/processes
  process ota_process: design=ota_process_design, executable=ota_exec
  process sm_process: design=sm_process_design, executable=sm_exec
  process ucm_process: design=ucm_process_design, executable=ucm_exec
package /ota/processes/process_design
  process design ota_process_design: executable=ota_exec
  process design sm_process_design: executable=sm_exec
  process design ucm_process_design: executable=ucm_exec
