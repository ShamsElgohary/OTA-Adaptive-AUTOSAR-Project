AUTOSAR XML (schema 00049)
package /ota/std_types
  std cpp implementation data type uint8_t: category=VALUE
  std cpp implementation data type uint32_t: category=VALUE
  std cpp implementation data type uint64_t: category=VALUE
package /ota/shared_types
  13 x std cpp implementation data type:
    Functiongroup: category=STRING
    FunctionGroupList: category=VECTOR, cpp-template-argument=Functiongroup
    TransferIdType: category=ARRAY, array-size=16, cpp-template-argument=uint8_t
    ByteVectorType: category=VECTOR, cpp-template-argument=uint8_t
    PackageManagerStatusType: category=TEXTTABLE, compu {7=kCleaningUp, 6=kRolledBack, 5=kRollingBack, 4=kActivated, 3=kActivating, 2=kProcessing, 1=kReady, 0=kIdle, 8=kVerifying}, type-reference=uint8_t
    OperationResultType: category=TEXTTABLE, compu {0=kSuccess, 1=kInsufficientMemory, 2=kIncorrectBlock, 3=kIncorrectSize, 4=kInvalidTransferId, 5=kOperationNotPermitted, 30=kIncorrectBlockSize, 6=kInsufficientData}, type-reference=uint8_t
    SwClusterInfoType: category=STRUCT
      cpp implementation data type element Name: type-reference=SwNameType
      cpp implementation data type element StrongRevisionLabelString: type-reference=StrongRevisionLabelString
      cpp implementation data type element SwClusterStateType: type-reference=SwClusterStateType
    SwNameType: category=STRING
    StrongRevisionLabelString: category=STRING
    SwClusterStateType: category=TEXTTABLE, compu {2=kUpdated, 1=kAdded, 0=kPresent, 3=kRemoved}, type-reference=uint8_t
    OperationResultOutput: category=STRUCT
      cpp implementation data type element OperationReturn: type-reference=OperationResultType
    TransferStartOutput: category=STRUCT
      cpp implementation data type element id: type-reference=TransferIdType
      cpp implementation data type element BlockSize: type-reference=uint32_t
      cpp implementation data type element TransferStartResult: type-reference=OperationResultType
    SwClusterInfoVectorType: category=VECTOR, cpp-template-argument=SwClusterInfoType
package /ota/errors/SM_ApplicationError
  4 x ap application error:
    kRejected: error-code=5
    kVerifyFailed: error-code=6
    kPrepareFailed: error-code=7
    kRollbackFailed: error-code=8
